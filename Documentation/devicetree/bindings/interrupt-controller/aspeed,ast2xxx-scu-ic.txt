## Documentation/devicetree/bindings/interrupt-controller/aspeed,ast2xxx-scu-ic.txt
```
Aspeed AST25XX and AST26XX SCU Interrupt Controller

Required Properties:
 - #interrupt-cells		: must be 1
 - compatible			: must be "aspeed,ast2500-scu-ic",
				  "aspeed,ast2600-scu-ic0" or
				  "aspeed,ast2600-scu-ic1"
 - reg				: address and size of the SCU register
				  associated with the controller
 - interrupts			: interrupt from the parent controller
 - interrupt-controller		: indicates that the controlle receives and
				  fires new interrupts for child busses

Example:

    syscon@1e6e2000 {
        ranges = <0 0x1e6e2000 0x1a8>;

        scu_ic: interrupt-controller@18 {
            #interrupt-cells = <1>;
            compatible = "aspeed,ast2500-scu-ic";
            reg = <0x18 0x04>;
            interrupts = <21>;
            interrupt-controller;
        };
    };
```

## Documentation/devicetree/bindings/soc/aspeed/xdma.txt
```
Aspeed AST25XX and AST26XX XDMA Engine

The XDMA Engine embedded in the AST2500 and AST2600 SOCs can perform automatic
DMA operations over PCI between the SOC (acting as a BMC) and a host processor.

Required properties:
 - compatible		: must be "aspeed,ast2500-xdma" or
			  "aspeed,ast2600-xdma"
 - reg			: contains the address and size of the memory region
			  associated with the XDMA engine registers
 - clocks		: clock specifier for the clock associated with the
			  XDMA engine
 - resets		: reset specifier for the syscon reset associated with
			  the XDMA engine
 - interrupts-extended	: two interrupt nodes; the first specifies the global
			  interrupt for the XDMA engine and the second
			  specifies the PCI-E reset or PERST interrupt.
 - scu			: a phandle to the syscon node for the system control
			  unit of the SOC
 - sdmc			: a phandle to the syscon node for the SDRAM memory
			  controller of the SOC
 - vga-mem		: contains the address and size of the VGA memory space
			  to be used by the XDMA engine

Optional properties:
 - pcie-device		: should be either "bmc" or "vga", corresponding to
			  which device should be used by the XDMA engine for
			  DMA operations. If this property is not set, the XDMA
			  engine will use the BMC PCI-E device.

Example:

    xdma@1e6e7000 {
        compatible = "aspeed,ast2500-xdma";
        reg = <0x1e6e7000 0x100>;
        clocks = <&syscon ASPEED_CLK_GATE_BCLK>;
        resets = <&syscon ASPEED_RESET_XDMA>;
        interrupts-extended = <&vic 6>, <&scu_ic ASPEED_AST2500_SCU_IC_PCIE_RESET_LO_TO_HI>;
        scu = <&syscon>;
        sdmc = <&edac>;
        pcie-device = "bmc";
        vga-mem = <0x9f000000 0x01000000>;
    };
```
